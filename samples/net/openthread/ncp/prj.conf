## CMakeLists.txt
```
# SPDX-License-Identifier: Apache-2.0

cmake_minimum_required(VERSION 3.13.1)

include($ENV{ZEPHYR_BASE}/cmake/app/boilerplate.cmake NO_POLICY_SCOPE)
project(ncp)

target_sources( app
    PRIVATE
        src/border-router.c
)

include($ENV{ZEPHYR_BASE}/samples/net/common/common.cmake)

set(gen_dir ${ZEPHYR_BINARY_DIR}/include/generated/)
```

## Kconfig
```
# Config options for OpenThread Border Router sample app

# Copyright (c) 2020 Tridonic GmbH & Co KG
# SPDX-License-Identifier: Apache-2.0

mainmenu "OpenThread Border Router"

menu "Application configuration"

config APPLICATION_VERSION
	string "Version number for the application"

endmenu

source "Kconfig.zephyr"
```

## prj.conf
```kconfig
# Generic networking options
CONFIG_NETWORKING=y
CONFIG_NET_UDP=y
CONFIG_NET_TCP=n
CONFIG_NET_IPV6=y
CONFIG_NET_IPV4=n

CONFIG_NET_CONFIG_NEED_IPV6=y
CONFIG_NET_CONFIG_NEED_IPV4=n

CONFIG_NET_SOCKETS=y
CONFIG_NET_SOCKETS_POSIX_NAMES=y
CONFIG_NET_SOCKETS_POLL_MAX=4
#CONFIG_NET_CONNECTION_MANAGER=y

# disable certain parts of Zephyr IPv6 stack
CONFIG_NET_IPV6_NBR_CACHE=n
CONFIG_NET_IPV6_MLD=n

# Kernel options
CONFIG_MAIN_STACK_SIZE=4096
CONFIG_ENTROPY_GENERATOR=y
CONFIG_TEST_RANDOM_GENERATOR=y
CONFIG_INIT_STACKS=y
#CONFIG_DEBUG_OPTIMIZATIONS=y

# Logging
CONFIG_NET_LOG=y
CONFIG_LOG=y
CONFIG_NET_STATISTICS=y
CONFIG_PRINTK=y

# Network buffers
CONFIG_NET_PKT_RX_COUNT=16
CONFIG_NET_PKT_TX_COUNT=16
CONFIG_NET_BUF_RX_COUNT=80
CONFIG_NET_BUF_TX_COUNT=80
CONFIG_NET_CONTEXT_NET_PKT_POOL=y

# Thread by default registers quite a lot addresses.
CONFIG_NET_IF_UNICAST_IPV6_ADDR_COUNT=6
CONFIG_NET_IF_MCAST_IPV6_ADDR_COUNT=8
CONFIG_NET_MAX_CONTEXTS=10

# Network shell
# CONFIG_NET_SHELL=y

# ???
# CONFIG_NET_CONFIG_SETTINGS=y

#CONFIG_NET_CONFIG_MY_IPV6_ADDR="2001:db8::2"
#CONFIG_NET_CONFIG_PEER_IPV6_ADDR="2001:db8::1"

# OpenThread NCP needs to be able to reboot
CONFIG_REBOOT=y

# Allow monitoring of stacks
# CONFIG_KERNEL_SHELL=y

# make sure that Bluetooth is off
CONFIG_BT=n

# OpenThread is using C++
CONFIG_CPLUSPLUS=y

# Other OpenThread dependencies
CONFIG_FLASH=y
CONFIG_FLASH_PAGE_LAYOUT=y
CONFIG_FLASH_MAP=y
CONFIG_MPU_ALLOW_FLASH_WRITE=y
CONFIG_NVS=y
CONFIG_SETTINGS=y

# mbedTLS tweaks
CONFIG_MBEDTLS_SSL_MAX_CONTENT_LEN=768
CONFIG_MBEDTLS_HEAP_SIZE=8192
# CONFIG_MBEDTLS_DEBUG=y
# CONFIG_MBEDTLS_DEBUG_LEVEL=4

# Enable OpenThread
CONFIG_NET_L2_OPENTHREAD=y

# Configure OpenThread
CONFIG_OPENTHREAD_CHANNEL=26
# Use PANID 0xffff to be able to commission
CONFIG_OPENTHREAD_PANID=65535

# Increase a few stack and other sizes for OpenThread
CONFIG_SYSTEM_WORKQUEUE_STACK_SIZE=2048
CONFIG_NET_TX_STACK_SIZE=2048
CONFIG_NET_RX_STACK_SIZE=5120
CONFIG_SHELL_STACK_SIZE=3072
CONFIG_OPENTHREAD_THREAD_STACK_SIZE=8192
CONFIG_OPENTHREAD_PKT_LIST_SIZE=20

# Settings for the Border Router
# from https://openthread.io/guides/border-router/build#build-and-flash-ncp

# CONFIG_OPENTHREAD_DHCP6_CLIENT is not set
CONFIG_OPENTHREAD_DHCP6_SERVER=y
CONFIG_OPENTHREAD_COMMISSIONER=y
CONFIG_OPENTHREAD_BORDER_AGENT=y
CONFIG_OPENTHREAD_BORDER_ROUTER=y
CONFIG_OPENTHREAD_UDP_FORWARD=y
CONFIG_OPENTHREAD_NCP=y
CONFIG_OPENTHREAD_ENABLE_SERVICE=y

# OpenThread shell interferes with Zephyr shell
CONFIG_OPENTHREAD_SHELL=n
```

## overlay-tri-n4m-br.conf
```kconfig
# TRI n4m BR
# Use UART_0 for Shell/Console
CONFIG_UART_SHELL_ON_DEV_NAME="UART_0"
CONFIG_UART_CONSOLE_ON_DEV_NAME="UART_0"
CONFIG_SHELL_PROMPT_UART="ncp-uart:~$ "

# Use UART_1 for NCP
CONFIG_UART_MCUX_1=y
CONFIG_OPENTHREAD_NCP_SPINEL_ON_UART_DEV_NAME="UART_1"

# Use USB-CDC-ACM for NCP
CONFIG_OPENTHREAD_NCP_SPINEL_ON_UART_ACM=y
CONFIG_OPENTHREAD_NCP_SPINEL_ON_UART_DEV_NAME="CDC_ACM_0"
CONFIG_STDOUT_CONSOLE=y
CONFIG_GPIO=y
CONFIG_USB=y
CONFIG_USB_DEVICE_STACK=y
CONFIG_USB_DEVICE_PRODUCT="OT BorderRouter K64"
CONFIG_LOG=y
CONFIG_USB_DRIVER_LOG_LEVEL_ERR=y
CONFIG_USB_CDC_ACM=y
CONFIG_USB_DEVICE_LOG_LEVEL_ERR=y
CONFIG_SERIAL=y
CONFIG_UART_INTERRUPT_DRIVEN=y
CONFIG_UART_LINE_CTRL=y
CONFIG_CDC_ACM_IAD=y
CONFIG_USB_REQUEST_BUFFER_SIZE=2048

# disable ethernet on K64
CONFIG_NET_L2_ETHERNET=n
CONFIG_ETH_MCUX_0=n

CONFIG_IEEE802154_RF2XX=y
CONFIG_NET_CONFIG_IEEE802154_DEV_NAME="RF2XX_0"
CONFIG_ISR_STACK_SIZE=4096
```

## src/border-router.c
```c
/* border-router.c - OpenThread NCP Border Router */

/*
 * Copyright (c) 2020 Tridonic GmbH & Co KG
 *
 * SPDX-License-Identifier: Apache-2.0
 */

#include <logging/log.h>
LOG_MODULE_REGISTER(ot_br, LOG_LEVEL_DBG);

#include <zephyr.h>

#define APP_BANNER "***** OpenThread NCP on Zephyr %s *****"

void main(void)
{
	LOG_INF(APP_BANNER, CONFIG_APPLICATION_VERSION);

	while (1) {
		k_sleep(MSEC_PER_SEC * 4U);
	}
}
```
